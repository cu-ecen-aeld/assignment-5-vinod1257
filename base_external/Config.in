## base_external/Config.in
```kconfig
menu "External Packages"
source "$BR2_EXTERNAL_project_base_PATH/package/aesd-ldd/Config.in"
source "$BR2_EXTERNAL_project_base_PATH/package/aesd-assignments/Config.in"
endmenu
```

## base_external/package/aesd-ldd/Config.in
```kconfig
config BR2_PACKAGE_AESD_LDD
	bool "aesd-ldd"
	help
	  Kernel modules for LDD examples (scull, misc-modules) from the
	  aesd-assignments repository.
```

## base_external/package/ldd/Config.in
```kconfig
config BR2_PACKAGE_LDD
	bool "ldd"
	help
	  Kernel modules for LDD examples (scull, misc-modules) from the
	  aesd-assignments repository.
```
